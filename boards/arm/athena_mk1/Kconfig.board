## boards/arm/athena_mk1/Kconfig.board
```kconfig
# Athena MK1 board configuration

# Copyright (c) 2019-2020 Nordic Semiconductor ASA
# SPDX-License-Identifier: Apache-2.0

if SOC_NRF5340_CPUAPP_QKAA

#config BOARD_NRF5340DK_NRF5340_CPUAPP
config BOARD_ATHENA_MK1_CPUAPP
	bool "Athena MK1 nRF5340 Application MCU"

#config BOARD_NRF5340DK_NRF5340_CPUAPP_NS
config BOARD_ATHENA_MK1_CPUAPP_NS
	bool "Athena MK1 nRF5340 Application MCU non-secure"

endif # SOC_NRF5340_CPUAPP_QKAA

#config BOARD_NRF5340DK_NRF5340_CPUNET
config BOARD_ATHENA_MK1_CPUNET
	bool "Athena MK1 nRF5340 Network MCU"
	depends on SOC_NRF5340_CPUNET_QKAA
```

## boards/arm/athena_mk1/Kconfig.defconfig
```kconfig
# Copyright (c) 2023 Nordic Semiconductor ASA
# SPDX-License-Identifier: Apache-2.0

if BOARD_ATHENA_MK1

config BOARD
	default "athena_mk1"


endif
```

## boards/arm/athena_mk1/athena_mk1_defconfig
```kconfig
# Copyright (c) 2023 Nordic Semiconductor ASA
# SPDX-License-Identifier: Apache-2.0

CONFIG_SOC_SERIES_NRF53X=y
CONFIG_SOC_NRF5340_CPUAPP_QKAA=y
CONFIG_BOARD_ATHENA_MK1=y

# Enable MPU
CONFIG_ARM_MPU=y

# Enable hardware stack protection
CONFIG_HW_STACK_PROTECTION=y

# Enable TrustZone-M
CONFIG_ARM_TRUSTZONE_M=y

# Enable SPI driver for nRF53 
#TODO: check if this is needed and is correct!
CONFIG_SPI=y

# enable GPIO
CONFIG_GPIO=y

CONFIG_PINCTRL=y
```
